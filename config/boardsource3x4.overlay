/*
 * Copyright (c) 2020 The ZMK Contributors
 *
 * SPDX-License-Identifier: MIT
 */

#include <dt-bindings/zmk/matrix_transform.h>

/ {
    kscan: kscan {
        compatible = "zmk,kscan";
        row-gpios = <&gpio0 2 0>, <&gpio0 3 0>, <&gpio0 4 0>;
        col-gpios = <&gpio0 9 0>, <&gpio0 10 0>, <&gpio0 11 0>, <&gpio0 7 0>;
        diode-direction = "COL2ROW";
    };
};
